## board/friendlyarm/nanopi_neo4/Kconfig
```kconfig
if TARGET_NANOPI_NEO4

config SYS_BOARD
	default "nanopi_neo4"

config SYS_VENDOR
	default "friendlyarm"

config SYS_CONFIG_NAME
	default "nanopi_neo4"

config BOARD_SPECIFIC_OPTIONS # dummy
	def_bool y

endif
```
